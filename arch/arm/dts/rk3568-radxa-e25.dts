// SPDX-License-Identifier: (GPL-2.0+ OR MIT)
/*
 * Copyright (c) 2020 Rockchip Electronics Co., Ltd.
 * Copyright (c) 2021 Radxa Limited.
 *
 */

/dts-v1/;
#include "rk3568-radxa-rock-3-compute-module-plus.dtsi"

/ {
	model = "Radxa E25";
	compatible = "radxa,e25", "rockchip,rk3568";

	led_sys: led-sys {
		u-boot,dm-pre-reloc;
		compatible = "regulator-fixed";
		regulator-name = "led_sys";
		enable-active-high;
		gpio = <&gpio0 RK_PC1 GPIO_ACTIVE_HIGH>;
		regulator-boot-on;
		regulator-always-on;
		vin-supply = <&vcc3v3_sys>;
	};
};
